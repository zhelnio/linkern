## src/br_tree/Config.in
```kconfig
source "$BR2_EXTERNAL_KERNMOD_PATH/package/hello/Config.in"
source "$BR2_EXTERNAL_KERNMOD_PATH/package/pci/Config.in"
source "$BR2_EXTERNAL_KERNMOD_PATH/package/misc/Config.in"
```

## src/br_tree/package/hello/Config.in
```kconfig
comment "hello-module needs a Linux kernel to be built"
	depends on !BR2_LINUX_KERNEL

config BR2_PACKAGE_HELLO_MODULE
	bool "hello-module"
	depends on BR2_LINUX_KERNEL
	help
		Hello World kernel module.
```

## src/br_tree/package/misc/Config.in
```kconfig
comment "misc-module needs a Linux kernel to be built"
	depends on !BR2_LINUX_KERNEL

config BR2_PACKAGE_XILPCI_MODULE
	bool "misc char device demo module"
	depends on BR2_LINUX_KERNEL
	help
		misc char device demo module
```

## src/br_tree/package/pci/Config.in
```kconfig
comment "hello-module needs a Linux kernel to be built"
	depends on !BR2_LINUX_KERNEL

config BR2_PACKAGE_PCIEDU_MODULE
	bool "PCI edu module"
	depends on BR2_LINUX_KERNEL
	help
		PCI edu kernel module.
```

## src/br_tree/package/pcix/Config.in
```kconfig
comment "Pcix-module needs a Linux kernel to be built"
	depends on !BR2_LINUX_KERNEL

config BR2_PACKAGE_XILPCI_MODULE
	bool "Pcix device demo module"
	depends on BR2_LINUX_KERNEL
	help
		Pcix device demo module
```

## src/config/buildroot_defconfig
```kconfig
BR2_x86_64=y
BR2_PACKAGE_HOST_LINUX_HEADERS_CUSTOM_4_11=y
BR2_TARGET_GENERIC_GETTY_PORT="ttyS0"
BR2_SYSTEM_DHCP="eth0"
BR2_LINUX_KERNEL=y
BR2_LINUX_KERNEL_CUSTOM_VERSION=y
BR2_LINUX_KERNEL_CUSTOM_VERSION_VALUE="4.11.3"
BR2_LINUX_KERNEL_USE_CUSTOM_CONFIG=y
BR2_LINUX_KERNEL_CUSTOM_CONFIG_FILE="board/qemu/x86_64/linux-4.11.config"
BR2_TARGET_ROOTFS_EXT2=y
# BR2_TARGET_ROOTFS_TAR is not set
```
